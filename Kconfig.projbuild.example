## Kconfig.projbuild.example
```kconfig
# Example Kconfig.projbuild for main project
# Copy this content to your main project's Kconfig.projbuild file
# to enable RF Module configuration via menuconfig

menu "ESP32 RF Module Configuration"

    config RF_MODULE_ENABLE_FLASH_STORAGE
        bool "Enable Flash Storage (NVS)"
        default y
        help
            Enable NVS flash storage for signal persistence.
            When enabled, received signals are automatically saved to flash.
            Requires nvs_flash component.

    config RF_MODULE_MAX_FLASH_SIGNALS
        int "Maximum Flash Storage Signals"
        range 1 20
        default 10
        depends on RF_MODULE_ENABLE_FLASH_STORAGE
        help
            Maximum number of signals to store in flash storage.
            Uses circular buffer, oldest signals are overwritten when full.

    config RF_MODULE_ENABLE_433MHZ
        bool "Enable 433MHz Frequency Support"
        default y
        help
            Enable support for 433MHz RF signals.
            Requires RCSwitch component.

    config RF_MODULE_ENABLE_315MHZ
        bool "Enable 315MHz Frequency Support"
        default y
        help
            Enable support for 315MHz RF signals.
            Requires TCSwitch component.

    config RF_MODULE_ENABLE_CC1101
        bool "Enable CC1101 Transceiver Support"
        default n
        help
            Enable CC1101 sub-1GHz transceiver (SPI).
            When enabled, use Begin(spi_host, sck, mosi, miso).
            Pin mapping: tx433=CS, rx433=GDO0, tx315=GDO2.
            Mutually exclusive with GPIO 433/315 in same build or use different pins.

    config RF_MODULE_ENABLE_SD_STORAGE
        bool "Enable SD Card Signal Storage"
        default n
        help
            Store signals on SD card (path set by main project).
            SD mount is done by main; RF module only reads/writes files on path.

    config RF_MODULE_MAX_STORED_SIGNALS
        int "Maximum Stored Signals (SD or NVS)"
        range 1 20
        default 10
        help
            Maximum number of signals to store (flash or SD).

    config RF_MODULE_ENABLE_MCP_TOOLS
        bool "Enable MCP Tools"
        default y
        help
            Enable MCP (Model Context Protocol) tools integration.
            Provides self.rf.* tools for AI-driven device control.
            Requires mcp_server component from the main project.

    config RF_MODULE_LOG_LEVEL
        int "Log Level"
        range 0 5
        default 3
        help
            Set the log level for RF module:
            0 = None
            1 = Error
            2 = Warning
            3 = Info
            4 = Debug
            5 = Verbose

endmenu
```
